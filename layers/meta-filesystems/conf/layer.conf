## layers/meta-testdistro/conf/bblayers.conf.sample
```bitbake
# LAYER_CONF_VERSION is increased each time build/conf/bblayers.conf
# changes incompatibly
LCONF_VERSION = "11"

# Remove or change to match this variable when setting DISTRO in local.conf
# Be sure to update the layer set below as appropriate
LCONF_DISTRO = "testdistro"

BBPATH = "${TOPDIR}"
BBFILES ?= ""

BBLAYERS ?= " \
  ##OEROOT##/openembedded-core/meta \
  ##OEROOT##/meta-tegra \
  ##OEROOT##/meta-tegra/contrib \
  ##OEROOT##/meta-oe \
  ##OEROOT##/meta-networking \
  ##OEROOT##/meta-filesystems \
  ##OEROOT##/meta-virtualization \
  ##OEROOT##/meta-testdistro \
  "
```

## layers/meta-testdistro/conf/distro/include/mender.inc
```bitbake
INHERIT_DISTRO += "mender-full tegra-mender-setup mender-workarounds mendersign"
MENDER_SERVER_URL = "https://hosted.mender.io"
MENDER_ARTIFACT_NAME ?= "${IMAGE_BASENAME}_${BUILDNAME}"
MENDER_FEATURES_ENABLE_remove = "mender-growfs-data"
```

## layers/meta-testdistro/conf/distro/testdistro.conf
```bitbake
DISTRO = "testdistro"
DISTRO_NAME = "Test Distro"
DISTRO_VERSION = "3.2"
DISTRO_CODENAME = "master-test"
BUILDNAME ?= "${DISTRO_VERSION}${DISTRO_LAYER_BUILDTAG}"
BUILDNAME[vardepvalue] = "${DISTRO_VERSION}"
SDK_VENDOR = "-testsdk"
SDK_VERSION := "${@'${DISTRO_VERSION}'.replace('snapshot-${DATE}','snapshot')}"

MAINTAINER = "Matt Madison <matt@madison.systems>"

TARGET_VENDOR = "-td"

# XXX-
#       The following is being replaced with
#       a TD_ prefixed variable. This setting
#       is being retained for compatibility with
#       existing workspaces that used the core-resident
#       sanity check.  Remove in future.
# -XXX
LAYER_CONF_VERSION = "10"

# New ${DISTRO}-<version> setting for sanity checks.
# Increment version number (and the corresponding
# setting int the template bblayers.conf.sample file)
# each time the layer settings are changed.
REQUIRED_TD_BBLAYERS_CONF_VERSION = "${DISTRO}-1"

LOCALCONF_VERSION = "1"
SITE_CONF_VERSION = "2"

OE_IMPORTS += "oeaws.botos3fetcher"

TEST_DEFAULT_DISTRO_FEATURES = "opengl ptest multiarch wayland vulkan systemd pam virtualization"

DISTRO_FEATURES ?= "${DISTRO_FEATURES_DEFAULT} ${TEST_DEFAULT_DISTRO_FEATURES}"

SDK_NAME = "${DISTRO}-${TCLIBC}-${SDK_ARCH}-${IMAGE_BASENAME}-${TUNE_PKGARCH}"
SDKPATH = "/opt/${DISTRO}/${SDK_VERSION}"

TESTQEMUDEPS = "${@bb.utils.contains("INCOMPATIBLE_LICENSE", "GPL-3.0", "", "packagegroup-core-device-devel",d)}"
DISTRO_EXTRA_RDEPENDS_append_qemuarm = " ${TESTQEMUDEPS}"
DISTRO_EXTRA_RDEPENDS_append_qemumips = " ${TESTQEMUDEPS}"
DISTRO_EXTRA_RDEPENDS_append_qemuppc = " ${TESTQEMUDEPS}"
DISTRO_EXTRA_RDEPENDS_append_qemux86 = " ${TESTQEMUDEPS}"
DISTRO_EXTRA_RDEPENDS_append_qemux86-64 = " ${TESTQEMUDEPS}"

TCLIBCAPPEND = ""

QEMU_TARGETS ?= "arm aarch64 i386 mips mipsel mips64 ppc x86_64"
# Other QEMU_TARGETS "mips64el sh4"

PREMIRRORS ??= "\
bzr://.*/.*   http://downloads.yoctoproject.org/mirror/sources/ \n \
cvs://.*/.*   http://downloads.yoctoproject.org/mirror/sources/ \n \
git://.*/.*   http://downloads.yoctoproject.org/mirror/sources/ \n \
gitsm://.*/.* http://downloads.yoctoproject.org/mirror/sources/ \n \
hg://.*/.*    http://downloads.yoctoproject.org/mirror/sources/ \n \
osc://.*/.*   http://downloads.yoctoproject.org/mirror/sources/ \n \
p4://.*/.*    http://downloads.yoctoproject.org/mirror/sources/ \n \
svn://.*/.*   http://downloads.yoctoproject.org/mirror/sources/ \n"

MIRRORS =+ "\
ftp://.*/.*      http://downloads.yoctoproject.org/mirror/sources/ \n \
http://.*/.*     http://downloads.yoctoproject.org/mirror/sources/ \n \
https://.*/.*    http://downloads.yoctoproject.org/mirror/sources/ \n"

# The CONNECTIVITY_CHECK_URI's are used to test whether we can succesfully
# fetch from the network (and warn you if not). To disable the test set
# the variable to be empty.
# Git example url: git://git.yoctoproject.org/yocto-firewall-test;protocol=git;rev=HEAD
CONNECTIVITY_CHECK_URIS ?= "https://www.example.com"

SANITY_TESTED_DISTROS ?= " \
            ubuntu-18.04 \n \
            ubuntu-18.10 \n \
            ubuntu-19.04 \n \
            ubuntu-19.10 \n \
            ubuntu-20.04 \n \
"

INHERIT_DISTRO = "debian devshell sstate sstate_mirror_update license remove-libtool uninative reproducible_build"
INHERIT_DISTRO += "distro_layer_buildinfo update-finished-booting-target testdistro-sanity"
require conf/distro/include/yocto-uninative.inc

GCCVERSION_aarch64 = "8.%"
SDKGCCVERSION = "10.%"
#
# OELAYOUT_ABI allows us to notify users when the format of TMPDIR changes in
# an incompatible way. Such changes should usually be detailed in the commit
# that breaks the format and have been previously discussed on the mailing list
# with general agreement from the core team.
#
OELAYOUT_ABI = "12"

PACKAGE_CLASSES ?= "package_rpm"

require conf/distro/include/security_flags.inc

LICENSE_FLAGS_WHITELIST_append = " commercial_faad2"

INIT_MANAGER = "systemd"

IMAGE_CLASSES_append_tegra = " tegrasign"

PREFERRED_PROVIDER_virtual/secure-os_tegra186 = "tos-keystore"
PREFERRED_PROVIDER_virtual/secure-os_tegra194 = "tos-keystore"
PREFERRED_RPROVIDER_libdevmapper = "lvm2"
```

## layers/meta-testdistro/conf/layer.conf
```bitbake
BBPATH .= ":${LAYERDIR}"
# Uncomment when we add recipes
BBFILES += "${LAYERDIR}/recipes-*/*/*.bb ${LAYERDIR}/recipes-*/*/*.bbappend"

BBFILE_COLLECTIONS += "testdistro"
BBFILE_PATTERN_testdistro = "^${LAYERDIR}/"
BBFILE_PRIORITY_testdistro = "50"

LAYERVERSION_testdistro = "4"
LAYERSERIES_COMPAT_testdistro = "zeus dunfell"
```

## layers/meta-testdistro/conf/local.conf.sample
```bitbake
MACHINE ??= "qemux86"
DISTRO ?= "testdistro"
#DL_DIR ?= "${TOPDIR}/downloads"
#SSTATE_DIR ?= "${TOPDIR}/sstate-cache"
#TMPDIR = "${TOPDIR}/tmp"
PACKAGE_CLASSES ?= "package_rpm"
SDKMACHINE ?= "x86_64"

#
# Extra image configuration defaults
#
# The EXTRA_IMAGE_FEATURES variable allows extra packages to be added to the generated 
# images. Some of these options are added to certain image types automatically. The
# variable can contain the following options:
#  "dbg-pkgs"       - add -dbg packages for all installed packages
#                     (adds symbol information for debugging/profiling)
#  "dev-pkgs"       - add -dev packages for all installed packages
#                     (useful if you want to develop against libs in the image)
#  "ptest-pkgs"     - add -ptest packages for all ptest-enabled packages
#                     (useful if you want to run the package test suites)
#  "tools-sdk"      - add development tools (gcc, make, pkgconfig etc.)
#  "tools-debug"    - add debugging tools (gdb, strace)
#  "eclipse-debug"  - add Eclipse remote debugging support
#  "tools-profile"  - add profiling tools (oprofile, exmap, lttng, valgrind)
#  "tools-testapps" - add useful testing tools (ts_print, aplay, arecord etc.)
#  "debug-tweaks"   - make an image suitable for development
#                     e.g. ssh root access has a blank password
# There are other application targets that can be used here too, see
# meta/classes/image.bbclass and meta/classes/core-image.bbclass for more details.
# We default to enabling the debugging tweaks.
#EXTRA_IMAGE_FEATURES = "debug-tweaks"

#
# Additional image features
#
# The following is a list of additional classes to use when building images which
# enable extra features. Some available options which can be included in this variable 
# are:
#   - 'buildstats' collect build statistics
#   - 'image-mklibs' to reduce shared library files size for an image
#   - 'image-prelink' in order to prelink the filesystem image
#   - 'image-swab' to perform host system intrusion detection
# NOTE: if listing mklibs & prelink both, then make sure mklibs is before prelink
# NOTE: mklibs also needs to be explicitly enabled for a given image, see local.conf.extended
USER_CLASSES ?= "buildstats image-mklibs image-prelink"


#
# Runtime testing of images
#
# The build system can test booting virtual machine images under qemu (an emulator)
# after any root filesystems are created and run tests against those images. To
# enable this uncomment this line. See classes/testimage(-auto).bbclass for
# further details.
#TEST_IMAGE = "1"
#
# Interactive shell configuration
#
# Under certain circumstances the system may need input from you and to do this it 
# can launch an interactive shell. It needs to do this since the build is 
# multithreaded and needs to be able to handle the case where more than one parallel
# process may require the user's attention. The default is iterate over the available
# terminal types to find one that works.
#
# Examples of the occasions this may happen are when resolving patches which cannot
# be applied, to use the devshell or the kernel menuconfig
#
# Supported values are auto, gnome, xfce, rxvt, screen, konsole (KDE 3.x only), none
# Note: currently, Konsole support only works for KDE 3.x due to the way
# newer Konsole versions behave
#OE_TERMINAL = "auto"
# By default disable interactive patch resolution (tasks will just fail instead):
PATCHRESOLVE = "noop"

#
# Disk Space Monitoring during the build
#
# Monitor the disk space during the build. If there is less that 1GB of space or less
# than 100K inodes in any key build location (TMPDIR, DL_DIR, SSTATE_DIR), gracefully
# shutdown the build. If there is less that 100MB or 1K inodes, perform a hard abort
# of the build. The reason for this is that running completely out of space can corrupt
# files and damages the build in ways which may not be easily recoverable.
BB_DISKMON_DIRS = "\
    STOPTASKS,${TMPDIR},1G,100K \
    STOPTASKS,${DL_DIR},1G,100K \
    STOPTASKS,${SSTATE_DIR},1G,100K \
    ABORT,${TMPDIR},100M,1K \
    ABORT,${DL_DIR},100M,1K \
    ABORT,${SSTATE_DIR},100M,1K" 

#
# Shared-state files from other locations
#
# As mentioned above, shared state files are prebuilt cache data objects which can 
# used to accelerate build time. This variable can be used to configure the system
# to search other mirror locations for these objects before it builds the data itself.
#
# This can be a filesystem directory, or a remote url such as http or ftp. These
# would contain the sstate-cache results from previous builds (possibly from other 
# machines). This variable works like fetcher MIRRORS/PREMIRRORS and points to the 
# cache locations to check for the shared objects.
# NOTE: if the mirror uses the same structure as SSTATE_DIR, you need to add PATH
# at the end as shown in the examples below. This will be substituted with the
# correct path within the directory structure.
#SSTATE_MIRRORS ?= "\
#file://.* http://someserver.tld/share/sstate/PATH;downloadfilename=PATH \n \
#file://.* file:///some/local/dir/sstate/PATH"


#
# Qemu configuration
#
# By default qemu will build with a builtin VNC server where graphical output can be
# seen. The two lines below enable the SDL backend too. This assumes there is a
# libsdl library available on your build system.
#PACKAGECONFIG_append_pn-qemu-native = " sdl"
#PACKAGECONFIG_append_pn-nativesdk-qemu = " sdl"
#ASSUME_PROVIDED += "libsdl-native"


# CONF_VERSION is increased each time build/conf/ changes incompatibly and is used to
# track the version of this file when it was generated. This can safely be ignored if
# this doesn't mean anything to you.
CONF_VERSION = "1"
```

## layers/meta-testdistro/conf/machine/jetson-tx2-cboot.conf
```bitbake
MACHINEOVERRIDES = "jetson-tx2:${MACHINE}"
IMAGE_FSTYPES = "tar.gz"
require conf/machine/jetson-tx2.conf
PACKAGE_EXTRA_ARCHS_append = " jetson-tx2"
PREFERRED_PROVIDER_virtual/bootloader = "cboot-prebuilt"
PARTITION_LAYOUT_TEMPLATE = "flash_${MACHINE}_custom.xml"
ROOTFSPART_SIZE_jetson-tx2-cboot = "6442450944"
INITRD_FSTYPES = "cpio.gz cpio.gz.cboot cpio.gz.cboot.bup-payload"
MACHINE_EXTRA_RDEPENDS += "tegra-boot-tools lvm2-udevrules"
SYSTEMD_DEFAULT_TARGET = "finished-booting.target"
MENDER_ROOTFS_PART_A_NUMBER_jetson-tx2-cboot = "APP"
MENDER_ROOTFS_PART_B_NUMBER_jetson-tx2-cboot = "APP_b"
MENDER_DATA_PART_NUMBER_jetson-tx2-cboot = "DATA"
MENDER_DATA_PART_SIZE_MB = "128"
MENDER_STORAGE_DEVICE_BASE = "/dev/mapper/"
MENDER_STORAGE_TOTAL_SIZE_MB = "${@int(d.getVar('EMMC_SIZE')) // 1024 // 1024}"
# Reduce the rootfs size by 10% to allow for cryptfs overhead
MENDER_IMAGE_ROOTFS_SIZE_DEFAULT = "${@int(d.getVar('ROOTFSPART_SIZE')) * 9 // 10240}"
```

## layers/meta-virtualization/conf/layer.conf
```bitbake
require orig-layer.conf
LAYERDEPENDS_virtualization-layer_remove = "filesystems-layer"
LAYERDEPENDS_virtualization-layer_remove = "meta-python"
```
